/*-----------------------------------------------------------------*
 *| zhihaox.zhou@intel.com | 11/08/2021  -  16:20 PM              |*
 *-----------------------------------------------------------------*
 *| mimxrt1060_evk.overlay | Adaptive NXP                         |*
 *-----------------------------------------------------------------*/

/*>Set uniform UART name and register driver */
&lpuart1{
	
	label  = "UART_1";
	status = "okay";
};
